## main/Kconfig.projbuild
```kconfig
menu "Wake-on-LAN Configuration"

    config WOL_WIFI_SSID
        string "WiFi SSID"
        default "myssid"
        help
            SSID of the local WiFi network.

    config WOL_WIFI_PASSWORD
        string "WiFi Password"
        default ""
        help
            Password for the WiFi network (leave empty for open networks).

    config WOL_TAILSCALE_AUTH_KEY
        string "Tailscale Auth Key"
        default "tskey-auth-XXXXXXXXXXXXXXXX-XXXXXXXXXXXXXXXXXXXXXXXXXXXXXXXX"
        help
            Auth key from https://login.tailscale.com/admin/settings/keys
            Tip: generate a reusable ephemeral key so the device does not
            linger in your admin panel when offline.

    config WOL_DEVICE_NAME
        string "Tailscale Device Name"
        default "esp32-wol"
        help
            Name this device will appear as in the Tailscale admin console.

    config WOL_TARGET_MAC
        string "Target PC MAC Address"
        default "AA:BB:CC:DD:EE:FF"
        help
            Ethernet MAC address of the NIC to wake (colon-separated hex).
            On Linux: ip link show   or   cat /sys/class/net/<iface>/address
            On Windows: ipconfig /all

    config WOL_LISTEN_PORT
        int "UDP Trigger Port"
        default 9999
        range 1024 65535
        help
            UDP port to listen on for incoming wake triggers (over Tailscale).
            Send any UDP packet to <esp32-tailscale-ip>:<port> to fire WoL.
            Example: echo wake | nc -u <tailscale-ip> 9999 -w1

    config WOL_BROADCAST_IP
        string "LAN Broadcast IP"
        default "255.255.255.255"
        help
            IP address to broadcast the magic packet to.
            255.255.255.255 works on most home networks.
            For a segmented network use the subnet broadcast, e.g. 192.168.1.255.

endmenu
```

## sdkconfig.defaults
```kconfig
# sdkconfig.defaults — NodeMCU-32S / ESP32S (no PSRAM)
# Based on microlink/examples/ping_pong_esp32/sdkconfig.defaults

# ── TLS / HTTPS (required for Tailscale coordination) ────────────────────────
CONFIG_ESP_TLS_USING_MBEDTLS=y
CONFIG_MBEDTLS_SSL_PROTO_TLS1_2=y
CONFIG_MBEDTLS_CERTIFICATE_BUNDLE=y
CONFIG_MBEDTLS_CERTIFICATE_BUNDLE_DEFAULT_CMN=y

# Shrink mbedTLS buffers to reclaim SRAM
CONFIG_MBEDTLS_ASYMMETRIC_CONTENT_LEN=y
CONFIG_MBEDTLS_SSL_IN_CONTENT_LEN=4096
CONFIG_MBEDTLS_SSL_OUT_CONTENT_LEN=4096
CONFIG_MBEDTLS_DYNAMIC_BUFFER=y

# ── HTTP/2 (Tailscale coordination uses HTTP/2) ───────────────────────────────
CONFIG_ESP_HTTP_CLIENT_ENABLE_HTTPS=y
# Note: nghttp2 HTTP/2 support is bundled in esp_http_client on ESP-IDF 5.x

# ── lwIP — reduced buffers for memory-constrained ESP32 ──────────────────────
CONFIG_LWIP_IPV4=y
CONFIG_LWIP_DHCP_DOES_ARP_CHECK=n
CONFIG_LWIP_IP4_FRAG=y
CONFIG_LWIP_IP4_REASSEMBLY=y
CONFIG_LWIP_TCP_MSS=1436
CONFIG_LWIP_TCP_SND_BUF_DEFAULT=4096
CONFIG_LWIP_TCP_WND_DEFAULT=4096
CONFIG_LWIP_TCP_RECVMBOX_SIZE=6
CONFIG_LWIP_UDP_RECVMBOX_SIZE=6

# ── Memory ────────────────────────────────────────────────────────────────────
# No PSRAM on NodeMCU-32S — intentionally NOT setting CONFIG_SPIRAM
CONFIG_ESP_MAIN_TASK_STACK_SIZE=6144

# ── MicroLink — tuned for minimal SRAM usage ─────────────────────────────────
# 24 KB coord buffer (minimum safe for small tailnets; increase to 32 if needed)
CONFIG_MICROLINK_COORD_BUFFER_SIZE_KB=16
# Max 4 peers; we only need 1 remote device to trigger WoL
CONFIG_MICROLINK_MAX_PEERS=4

# ── WiFi — reduced buffers ────────────────────────────────────────────────────
CONFIG_ESP_WIFI_STATIC_RX_BUFFER_NUM=6
CONFIG_ESP_WIFI_DYNAMIC_RX_BUFFER_NUM=16
CONFIG_ESP_WIFI_TX_BUFFER_TYPE=1
CONFIG_ESP_WIFI_DYNAMIC_TX_BUFFER_NUM=16
CONFIG_ESP_WIFI_AMPDU_TX_ENABLED=n
CONFIG_ESP_WIFI_AMPDU_RX_ENABLED=n

# ── Flash / partition table ───────────────────────────────────────────────────
CONFIG_ESPTOOLPY_FLASHSIZE_4MB=y
CONFIG_PARTITION_TABLE_SINGLE_APP_LARGE=y

# ── Compiler ──────────────────────────────────────────────────────────────────
CONFIG_COMPILER_OPTIMIZATION_SIZE=y

# ── Logging ───────────────────────────────────────────────────────────────────
CONFIG_LOG_DEFAULT_LEVEL_INFO=y
CONFIG_LOG_MAXIMUM_LEVEL_INFO=y

# ── FreeRTOS ─────────────────────────────────────────────────────────────────
CONFIG_FREERTOS_HZ=1000
```
